## arch/arm/configs/friendlyarm_mini210s_defconfig
```kconfig
CONFIG_ARCH_S5PCxx=y
CONFIG_CPU_V7=y
CONFIG_CPU_32v7=y
CONFIG_BOARDINFO="Mini 210s"
CONFIG_ARCH_BAREBOX_MAX_BARE_INIT_SIZE=0x1ff0
CONFIG_ARCH_SAMSUNG=y
CONFIG_CPU_S5PV210=y
CONFIG_MACH_MINI210S=y
CONFIG_S3C_LOWLEVEL_INIT=y
CONFIG_S3C_PLL_INIT=n
CONFIG_S3C_SDRAM_INIT=y
CONFIG_LED=y
CONFIG_LED_GPIO=y
CONFIG_LED_TRIGGERS=y

### driver
CONFIG_DRIVER_SERIAL_S3C=y
CONFIG_DRIVER_NET_DM9K=y

### env
CONFIG_DEFAULT_ENVIRONMENT_GENERIC_NEW=y
CONFIG_DEFAULT_ENVIRONMENT_PATH="arch/arm/boards/friendlyarm-mini210s/env"

### net
CONFIG_NET=y
CONFIG_NET_PING=y
CONFIG_NET_DHCP=y

### fs
CONFIG_FS_TFTP=y

### hush
CONFIG_HUSH_FANCY_PROMPT=y
CONFIG_CMDLINE_EDITING=y
CONFIG_AUTO_COMPLETE=y

### cmd
# general
CONFIG_CMD_ECHO_E=y
CONFIG_CMD_GO=y
CONFIG_CMD_RESET=y
CONFIG_CMD_TIMEOUT=y
CONFIG_CMD_EXPORT=y

# board
CONFIG_CMD_LED=y
CONFIG_CMD_LED_TRIGGER=y

# net
CONFIG_CMD_TFTP=y
```
